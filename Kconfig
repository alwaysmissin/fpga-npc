## Kconfig
```kconfig
mainmenu "NPC Configuration Menu"

menu "Testing and Debugging"

config TRACE
  bool "Enable tracer"
  default y

config TRACE_START
  depends on TRACE
  int "When tracing is enabled (unit: number of instructions)"
  default 0

config TRACE_END
  depends on TRACE
  int "When tracing is disabled (unit: number of instructions)"
  default 10000

config ITRACE
  depends on TRACE
  bool "Enable instruction tracer"
  default y

config ITRACE_COND
  depends on ITRACE
  string "Only trace instructions when the condition is true"
  default "true"

config MTRACE
  depends on TRACE
  bool "Enable memory tracer"
  default y

config MTRACE_COND
  depends on MTRACE
  string "Only trace memory operations when the condition is true"
  default "true"

config DTRACE
  depends on TRACE
  bool "Enable device tracer"
  default y

config DTRACE_COND
  depends on DTRACE
  string "Only trace memory operations when the condition is true"
  default "true"

config WATCHPOINT
  bool "Enable watchpoint"
  default n

config DIFFTEST
  bool "Enable differential testing"
  default n

config WAVEFORM
  bool "Enable waveform dump"
  default n

config WAVEFORM_DIVIDE
  depends on WAVEFORM
  bool "Enable waveform divide"
  default n

config WAVEFORM_OVERLAP
  depends on WAVEFORM_DIVIDE
  bool "Enable waveform overlap"
  default n

config DUMP_WHEN_SDRAM
  depends on WAVEFORM
  bool "Dump when SDRAM is accessed"
  default y

endmenu
```
